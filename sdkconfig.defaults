## sdkconfig.defaults
```kconfig
# Cấu hình mặc định chung cho tất cả các loại ESP
# File này sẽ được áp dụng trước, sau đó file sdkconfig.defaults.<target> sẽ ghi đè

# Cấu hình Flash
CONFIG_ESPTOOLPY_FLASHSIZE_4MB=y
CONFIG_ESPTOOLPY_FLASHMODE_DIO=y

# Cấu hình Partition Table - dùng custom partition
CONFIG_PARTITION_TABLE_CUSTOM=y
CONFIG_PARTITION_TABLE_OFFSET=0x8000

# Cấu hình Log
CONFIG_BOOTLOADER_LOG_LEVEL_INFO=y
CONFIG_LOG_DEFAULT_LEVEL_INFO=y

# Cấu hình WiFi
CONFIG_ESP_WIFI_STATIC_RX_BUFFER_NUM=10
CONFIG_ESP_WIFI_DYNAMIC_RX_BUFFER_NUM=32
CONFIG_ESP_WIFI_DYNAMIC_TX_BUFFER_NUM=32

# Cấu hình HTTP Server (cho WiFi Config AP)
CONFIG_HTTPD_MAX_REQ_HDR_LEN=1024
CONFIG_HTTPD_MAX_URI_LEN=512

# Cấu hình Stack Size (tránh overflow khi dùng OTA + HTTP client)
CONFIG_ESP_SYSTEM_EVENT_TASK_STACK_SIZE=4096
CONFIG_ESP_MAIN_TASK_STACK_SIZE=8192

# Cấu hình mbedTLS cho HTTPS qua Cloudflare
CONFIG_MBEDTLS_SSL_PROTO_TLS1_3=y
CONFIG_MBEDTLS_HKDF_C=y
CONFIG_MBEDTLS_SSL_IN_CONTENT_LEN=16384
CONFIG_MBEDTLS_SSL_OUT_CONTENT_LEN=4096
```

## sdkconfig.defaults.esp32
```kconfig
# Cấu hình riêng cho ESP32 (Xtensa dual-core, 240MHz)
# Chip gốc với đầy đủ tính năng: WiFi, BT Classic, BLE

# Chọn target ESP32
CONFIG_IDF_TARGET="esp32"

# Cấu hình Partition Table
CONFIG_PARTITION_TABLE_CUSTOM_FILENAME="partitions/partitions_esp32_4MB.csv"
CONFIG_PARTITION_TABLE_FILENAME="partitions/partitions_esp32_4MB.csv"

# Cấu hình Flash - ESP32 thường dùng module 4MB
CONFIG_ESPTOOLPY_FLASHSIZE_4MB=y
CONFIG_ESPTOOLPY_FLASHFREQ_40M=y

# Cấu hình CPU - Dual core
CONFIG_FREERTOS_UNICORE=n

# Cấu hình PSRAM (nếu có module WROVER)
# CONFIG_ESP32_SPIRAM_SUPPORT=y
# CONFIG_SPIRAM_SPEED_80M=y
```

## sdkconfig.defaults.esp32c3
```kconfig
# Cấu hình riêng cho ESP32-C3 (RISC-V single-core, 160MHz)
# Chip nhỏ gọn với WiFi + BLE 5.0

# Chọn target ESP32-C3
CONFIG_IDF_TARGET="esp32c3"

# Cấu hình Partition Table
CONFIG_PARTITION_TABLE_CUSTOM_FILENAME="partitions/partitions_esp32c3_4MB.csv"
CONFIG_PARTITION_TABLE_FILENAME="partitions/partitions_esp32c3_4MB.csv"

# Cấu hình Flash - C3 thường dùng module 4MB
CONFIG_ESPTOOLPY_FLASHSIZE_4MB=y
CONFIG_ESPTOOLPY_FLASHFREQ_80M=y
CONFIG_ESPTOOLPY_FLASHMODE_DIO=y

# Cấu hình USB Serial/JTAG (C3 có tích hợp USB-Serial)
CONFIG_USJ_ENABLE_USB_SERIAL_JTAG=y
```

## sdkconfig.defaults.esp32s3
```kconfig
# Cấu hình riêng cho ESP32-S3 (Xtensa dual-core, 240MHz)
# Chip mạnh mẽ với WiFi + BLE 5.0, hỗ trợ AI (vector instructions), USB OTG

# Chọn target ESP32-S3
CONFIG_IDF_TARGET="esp32s3"

# Cấu hình Partition Table
CONFIG_PARTITION_TABLE_CUSTOM_FILENAME="partitions/partitions_esp32s3_16MB.csv"
CONFIG_PARTITION_TABLE_FILENAME="partitions/partitions_esp32s3_16MB.csv"

# Cấu hình Flash - S3 thường dùng module flash lớn
CONFIG_ESPTOOLPY_FLASHSIZE_16MB=y
CONFIG_ESPTOOLPY_FLASHFREQ_80M=y
CONFIG_ESPTOOLPY_FLASHMODE_QIO=y

# Cấu hình CPU - Dual core & 240MHz
CONFIG_FREERTOS_UNICORE=n
CONFIG_ESP_DEFAULT_CPU_FREQ_MHZ_240=y
CONFIG_ESP_DEFAULT_CPU_FREQ_MHZ=240

# Cấu hình PSRAM (S3 thường có module N16R8 = 16MB Flash + 8MB PSRAM)
# CONFIG_SPIRAM=y
# CONFIG_SPIRAM_MODE_OCT=y
# CONFIG_SPIRAM_SPEED_80M=y

# Cấu hình USB OTG
# CONFIG_USB_OTG_SUPPORTED=y
```
